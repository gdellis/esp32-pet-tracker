## firmware/sdkconfig.defaults
```kconfig
CONFIG_IDF_TARGET_ESP32C6=y
CONFIG_IDF_TARGET="esp32c6"

CONFIG_ESPTOOLPY_FLASHSIZE_4MB=y
CONFIG_ESPTOOLPY_FLASHSIZE="4MB"

CONFIG_PARTITION_TABLE_SINGLE_APP=y

CONFIG_ESP_CONSOLE_ESP_NVS_DISABLED=n
CONFIG_ESP_CONSOLE_UART_CUSTOM=y
CONFIG_ESP_CONSOLE_UART_NUM_0=y

CONFIG_GPIO_CTRL_FUNC_IN_IRAM=y

CONFIG_ESP_MAIN_TASK_STACK_SIZE=8192
CONFIG_ESP_SYSTEM_EVENT_TASK_STACK_SIZE=4096
CONFIG_FREERTOS_IDLE_TASK_STACKSIZE=4096
CONFIG_PTHREAD_TASK_STACK_SIZE_DEFAULT=4096
```
